## board/jxl/Kconfig
```kconfig
if TARGET_JXL

config SYS_BOARD
	default "jxl"

config SYS_CONFIG_NAME
	default "jxl"

endif
```

## configs/jxl_defconfig
```kconfig
CONFIG_ARM=y
CONFIG_ARM64=y
CONFIG_POSITION_INDEPENDENT=y
CONFIG_TARGET_JXL=y
CONFIG_TEXT_BASE=0x40080000
CONFIG_SYS_MALLOC_LEN=0x200000
CONFIG_SYS_MALLOC_F_LEN=0x8000
CONFIG_NR_DRAM_BANKS=1
CONFIG_ENV_ADDR=0x047F0000
CONFIG_ENV_SIZE=0x10000
CONFIG_ENV_SECT_SIZE=0x10000
CONFIG_HAS_CUSTOM_SYS_INIT_SP_ADDR=y
CONFIG_CUSTOM_SYS_INIT_SP_ADDR=0x40200000
CONFIG_DEFAULT_DEVICE_TREE="jxl"
CONFIG_SYS_LOAD_ADDR=0x41000000
# CONFIG_DISPLAY_CPUINFO is not set
# CONFIG_DISPLAY_BOARDINFO is not set
CONFIG_CMD_FLASH=y
CONFIG_SYS_PROMPT="jxl> "
# CONFIG_CMD_BDI is not set
# CONFIG_CMD_CONSOLE is not set
# CONFIG_CMD_IMI is not set
# CONFIG_CMD_XIMG is not set
# CONFIG_CMD_NET is not set
# CONFIG_CMD_NFS is not set
# CONFIG_MMC is not set
CONFIG_DM=y
CONFIG_DM_SERIAL=y
CONFIG_ENV_IS_IN_FLASH=y
CONFIG_OF_CONTROL=y
CONFIG_OF_EMBED=y
CONFIG_MTD=y
# CONFIG_DM_MTD is not set
CONFIG_MTD_NOR_FLASH=y
CONFIG_FLASH_CFI_DRIVER=y
# CONFIG_SYS_FLASH_CFI_WIDTH_16BIT is not set
CONFIG_SYS_FLASH_CFI_WIDTH_32BIT=y
CONFIG_CFI_FLASH_USE_WEAK_ACCESSORS=y
CONFIG_SYS_FLASH_CFI=y
CONFIG_SYS_MAX_FLASH_SECT=256
CONFIG_SYS_MAX_FLASH_BANKS=1
CONFIG_PL01X_SERIAL=y
CONFIG_DEBUG_UART=y
CONFIG_DEBUG_UART_PL011=y
CONFIG_DEBUG_UART_BASE=0x9000000
CONFIG_DEBUG_UART_CLOCK=24000000
CONFIG_DEBUG_UART_SHIFT=2
# CONFIG_NET is not set
# CONFIG_EFI_LOADER is not set
```
